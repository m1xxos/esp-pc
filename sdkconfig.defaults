## sdkconfig.defaults
```kconfig
CONFIG_LOG_DEFAULT_LEVEL_INFO=y
CONFIG_FREERTOS_HZ=1000
CONFIG_ESP_TASK_WDT=y
CONFIG_ESP_TASK_WDT_TIMEOUT_S=10
CONFIG_NVS_ENCRYPTION=n
```

## sdkconfig.defaults.matter
```kconfig
# Matter profile defaults (base placeholders)
CONFIG_BT_ENABLED=y
CONFIG_BT_BLE_ENABLED=y
CONFIG_BT_NIMBLE_ENABLED=y
CONFIG_BT_BLUEDROID_ENABLED=n
CONFIG_MBEDTLS_HKDF_C=y
CONFIG_PARTITION_TABLE_SINGLE_APP=n
CONFIG_PARTITION_TABLE_SINGLE_APP_LARGE=n
CONFIG_PARTITION_TABLE_CUSTOM=y
CONFIG_PARTITION_TABLE_CUSTOM_FILENAME="partitions_matter.csv"
CONFIG_ESPTOOLPY_FLASHSIZE_4MB=y
CONFIG_ESP_PHY_ENABLE_USB=y
```

## sdkconfig.defaults.zigbee
```kconfig
# Zigbee profile defaults (base placeholders)
CONFIG_ESP_PHY_ENABLE_USB=y
CONFIG_ESP_COREDUMP_ENABLE_TO_FLASH=n
```
